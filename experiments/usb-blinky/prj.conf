## CMakeLists.txt
```
cmake_minimum_required(VERSION 3.20.0)
find_package(Zephyr REQUIRED HINTS $ENV{ZEPHYR_BASE})
project(blinky_cdc)
target_sources(app PRIVATE src/main.c)
```

## prj.conf
```kconfig
CONFIG_GPIO=y
CONFIG_PRINTK=y
CONFIG_CLOCK_CONTROL_NRF_K32SRC_RC=y
```

## legacy.conf
```kconfig
CONFIG_USB_DEVICE_STACK_NEXT=n
CONFIG_CDC_ACM_SERIAL_INITIALIZE_AT_BOOT=n
CONFIG_USB_DEVICE_STACK=y
CONFIG_USB_DEVICE_INITIALIZE_AT_BOOT=y
CONFIG_USB_CDC_ACM=y
CONFIG_USB_DEVICE_PRODUCT="zb-remote legacy"
CONFIG_USB_DEVICE_PID=0x0004
```

## src/main.c
```c
#include <zephyr/kernel.h>
#include <zephyr/drivers/gpio.h>
#include <zephyr/sys/printk.h>
static const struct gpio_dt_spec led = GPIO_DT_SPEC_GET(DT_ALIAS(led0), gpios);
int main(void)
{
	gpio_pin_configure_dt(&led, GPIO_OUTPUT_ACTIVE);
	for (int n = 0;; n++) {
		gpio_pin_toggle_dt(&led);
		printk("blinky alive %d\n", n);
		k_msleep(500);
	}
}
```
